## dev_wifi_a/Kconfig.liteos_m.board
```kconfig
config BOARD_DEV_WIFI_A
    bool "select board DEV_WIFI_A"
    depends on SOC_ASR5822S
```

## dev_wifi_a/Kconfig.liteos_m.defconfig.board
```kconfig
if BOARD_DEV_WIFI_A
config BOARD
    string
    default "DEV.WIFI.A"

endif #BOARD_DEV_WIFI_A
```
